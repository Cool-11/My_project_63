## src/application/samples/peripheral/My_project_63/Kconfig
```kconfig
#===============================================================================
# @brief    Kconfig file
#===============================================================================
menu "My Project 63 Configuration"

config MY_PROJECT_63_ENABLE_STARTUP_LOG
    bool "Enable startup logs"
    default y
    help
        Print startup phase logs for fast bring-up diagnostics.

endmenu
```
